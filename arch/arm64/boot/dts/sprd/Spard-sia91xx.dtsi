/* Copyright (c) 2018, The Linux Foundation. All rights reserved.
 *
 * This program is free software; you can redistribute it and/or modify
 * it under the terms of the GNU General Public License version 2 and
 * only version 2 as published by the Free Software Foundation.
 *
 * This program is distributed in the hope that it will be useful,
 * but WITHOUT ANY WARRANTY; without even the implied warranty of
 * MERCHANTABILITY or FITNESS FOR A PARTICULAR PURPOSE.  See the
 * GNU General Public License for more details.
 */


/ {
	fragment {
		target-path = "/";
		__overlay__ {
			sia91xx_L: sia91xx@L {
				compatible = "si,sia91xx";
				si,si_pa_type = "sia9177";
				si,si_pa_reset = <&ap_gpio 129 0>;
				si,si_pa_disable_pin = <0>;
				channel_num = <0>;
			};
		};
	};
};

