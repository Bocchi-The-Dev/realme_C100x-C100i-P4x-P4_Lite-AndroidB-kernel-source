/*ATL 68K*/
/ {
	fragment {
			target-path = "/";
			__overlay__ {

			bat: battery {
				compatible = "simple-battery";
				charge-full-design-microamp-hours = <4700000>;
				charge-term-current-microamp = <60000>;
				constant-charge-voltage-max-microvolt = <4340000>;
				factory-internal-resistance-micro-ohms = <91000>;
				voltage-min-design-microvolt = <3457000>;
				fast-charge-threshold-microvolt = <4100000>;
				fullbatt-voltage = <4300000>;
				fullbatt-current = <120000>;
				first-fullbatt-current = <150000>;
				fullbatt-track-end-vol = <4295000>;
				fullbatt-track-end-cur = <130000>;
				first-calib-voltage = <3580000>;
				first-calib-capacity = <40>;
				batt-ovp-threshold-microvolt = <4800000>;

				ir-cv-offset-microvolt = <100000>;
				ir-rc-micro-ohms = <20000>;
				ir-us-upper-limit-microvolt = <4500000>;

				ocv-capacity-celsius = <20>;
				ocv-capacity-table-0 = <4421000 100>, <4364000 95>, <4310000 90>,
							<4251000 85>, <4191000 80>, <4133000 75>,
							<4079000 70>, <4029000 65>, <3983000 60>,
							<3922000 55>, <3881000 50>, <3853000 45>,
							<3830000 40>, <3811000 35>, <3796000 30>,
							<3774000 25>, <3752000 20>, <3728000 15>,
							<3697000 10>, <3686000 5>, <3400000 0>;
				voltage-temp-table = <958266 600>, <917838 650>, <872102 700>, <821932 750>,
							<768436 800>, <713168 850>, <657516 900>,
							<602736 950>, <550404 1000>, <501636 1050>,
							<456864 1100>, <416390 1150>, <380379 1200>,
							<348695 1250>, <320955 1300>, <296950 1350>,
							<276277 1400>, <258473 1450>, <243213 1500>,
							<230162 1550>, <219004 1600>, <209615 1650>,
							<201601 1700>, <194717 1750>, <188820 1800>,
							<183777 1850>, <179442 1900>, <175681 1950>;
				capacity-temp-table = <45 100>, <25 100>, <15 99>, <10 98>, <0 90>, <(-10) 80>, <(-20) 66>;
				resistance-temp-table = <45 80>, <25 100>, <10 197>, <0 1293>, <(-10) 1434>, <(-20) 1573>;


				charge-sdp-current-microamp = <500000 500000>;
				charge-dcp-current-microamp = <2000000 2500000>;
				charge-cdp-current-microamp = <1500000 1500000>;
				charge-unknown-current-microamp = <1050000 1050000>;
				charge-fchg-current-microamp = <3250000 2000000>;
				charge-flash-current-microamp = <5000000 2700000>;
				charge-wl-bpp-current-microamp = <1000000 1000000>;
				charge-wl-epp-current-microamp = <2000000 1000000>;

				cap-calib-energy-density-ocv-table = <3350000 3800000>, <4150000 4350000>;
				cap-track-energy-density-ocv-table = <3400000 3722000>;

				dcp-jeita-temp-table = <1000 1030 0 4340000>, <1150 1180 700000 4340000>,
					<1450 1420 2000000 4340000>, <1600 1570 700000 4100000>;
				sdp-jeita-temp-table = <1000 1030 0 4340000>, <1150 1180 500000 4340000>,
					<1450 1420 500000 4340000>, <1600 1570 500000 4100000>;
				cdp-jeita-temp-table = <1000 1030 0 4340000>, <1150 1180 700000 4340000>,
					<1450 1420 1500000 4340000>, <1600 1570 700000 4100000>;
				unknown-jeita-temp-table = <1000 1030 0 4340000>, <1150 1180 700000 4340000>,
					<1450 1420 1050000 4340000>, <1600 1570 700000 4100000>;
				fchg-jeita-temp-table = <1000 1030 0 4340000>, <1150 1180 700000 4340000>,
					<1450 1420 3250000 4340000>, <1600 1570 700000 4100000>;
				flash-jeita-temp-table = <1000 1030 0 4340000>, <1150 1180 1000000 4340000>,
					<1450 1420 5000000 4340000>, <1600 1570 1000000 4100000>;
				wl-bpp-jeita-temp-table = <1000 1030 0 4340000>, <1150 1180 500000 4340000>,
					<1450 1420 1000000 4340000>, <1600 1570 5000000 4100000>;
				wl-epp-jeita-temp-table = <1000 1030 0 4340000>, <1150 1180 500000 4340000>,
					<1450 1420 2000000 4340000>, <1600 1570 500000 4100000>;
			};
		};
	};
};
