## drivers/misc/luxhardwareinfo/Kconfig
```kconfig
config LUX_HARDWARE_INFO
	tristate "CONFIG_LUX_HARDWARE_INFO"
	help
		CONFIG_LUX_HARDWARE_INFO
```

## drivers/power/oplus/dft/Kconfig
```kconfig
# SPDX-License-Identifier: GPL-2.0-only
# Copyright (C) 2020-2030 Oplus. All rights reserved.

# Qcom platform feature

# MTK platform feature

# common feature
source "drivers/power/oplus/dft/common/feedback/Kconfig"
```

## drivers/unisoc_platform/cpufreq/Kconfig
```kconfig
# SPDX-License-Identifier: GPL-2.0-only
#
# unisoc multi freq control for cpufreq
#

config UNISOC_MULTI_FREQ_CONTROL
	tristate "enable unisoc multi freq control"
	depends on CPU_FREQ
	help
	This option enables cpufreq high level freq control for user.

config UNISOC_FIX_FREQ
	bool "enable unisoc fix freq for debug"
	depends on UNISOC_MULTI_FREQ_CONTROL
	default n
	help
	Add scaling_fix_freq ops for debug.

config UNISOC_FREQLINK
	tristate "enable unisoc freqlink driver"
	depends on CPU_FREQ && DEVFREQ_SPRD_DDR_DVFS
	default n
	help
	  Spreadtrum freqlink driver for cpu and ddr.
	  Say Y here to support the cpu/ddr freqlink function.
	  It provides freqlink table sysfs nodes to set the
	  target ddr frequencies with different cpu frequencies.
```

## kernel_modules/common/camera/cam_sys/Kconfig
```kconfig
#
# Unisoc Camera device (NEW)configuration
#
menu "Unisoc Camera Platform"

config UNISOC_CAMERA_CAMSYS
	tristate "Unisoc Camera"
	depends on UNISOC_CAMERA_FLASH_DRV && UNISOC_CAMERA_SENSOR && UNISOC_CAMERA_POWER

config UNISOC_CAMERA_UMS512
	tristate "Unisoc Camera Sharkl5pro"
	depends on UNISOC_CAMERA_FLASH_DRV && UNISOC_CAMERA_SENSOR && UNISOC_CAMERA_POWER && UNISOC_CAMERA_CAMSYS

config UNISOC_CAMERA_UMS9621
	tristate "Unisoc Camera QogirN6L"
	depends on UNISOC_CAMERA_FLASH_DRV && UNISOC_CAMERA_SENSOR && UNISOC_CAMERA_POWER && UNISOC_CAMERA_CAMSYS
endmenu
```

## kernel_modules/common/camera/flash/flash_drv/Kconfig
```kconfig
#
# Unisoc Camera device (NEW)configuration
#
menu "Unisoc Camera Platform"

config UNISOC_CAMERA_FLASH_DRV
	tristate "Unisoc Camera Flash Drv"
endmenu
```

## kernel_modules/common/camera/flash/ocp8137/Kconfig
```kconfig
#
# Unisoc Camera device (NEW)configuration
#
menu "Unisoc Camera Platform"

config UNISOC_CAMERA_OCP8137
	tristate "Unisoc Camera Ocp8137"
	depends on UNISOC_CAMERA_FLASH_DRV
endmenu
```

## kernel_modules/common/camera/mmdvfs/Kconfig
```kconfig
#
# Unisoc Camera device (NEW)configuration
#
menu "Unisoc Camera Platform"

config UNISOC_CAMERA_DVFS
	tristate "Unisoc Camera Dvfs"
	depends on UNISOC_CAMERA_POWER
	help
	  This is support to UNISOC mmdvfs.
	  If you want to use camera dvfs.
	  Please say “m”.
	  If not configured, voltage issues may occur.

endmenu
```

## kernel_modules/common/camera/power/Kconfig
```kconfig
#
# Unisoc Camera device (NEW)configuration
#
menu "Unisoc Camera Platform"

config UNISOC_CAMERA_POWER
	tristate "Unisoc Camera Power"
endmenu
```

## kernel_modules/kernel5.15/wcn/bluetooth/driver/Kconfig
```kconfig
#
# Unisoc Bluetooth device configuration
#
menu "Unisoc Bluetooth Device Drivers"
config UNISOC_WCN_BT
	tristate "SPRDBT_TTY"
	help
	  This is support wcn chip for Unisoc.
	  if you want to use 23xx series wcn chip of Unisoc.
	  please say "y".

endmenu
```

## kernel_modules/kernel5.15/wcn/fm/driver/Kconfig
```kconfig
#
# Unisoc FM device configuration
#
menu "Unisoc FM Device Drivers"
config UNISOC_WCN_FM
	tristate "SPRD_FM"
	help
	  This is support wcn chip for Unisoc.
	  if you want to use 23xx series wcn chip of Unisoc.
	  please say "y".

endmenu
```

## kernel_modules/kernel5.15/wcn/gnss/unisoc_gnss/gnss_pmnotify_ctl/Kconfig
```kconfig
#
# Unisoc GNSS device (NEW )configuration
#
menu "Unisoc GNSS Device Drivers"
config UNISOC_GNSS_PMNOTIFY_CTL
	tristate "Gnss pmnotify ctl support"
	help
	Choose Y here if you want to support gnss_pmnotify_ctl function
        for unisoc wcn sc23xx series chip.

	In order to control your ext wcn chip, you will need enable it.
	that include "boot, log, procfs, debugfs, at cmd, loopcheck, dumpmem,
	reset, reboot,etc"

config SC23XX
	bool "SC23XX chip Support"
	#depends on MMC
	default n
	help
	  This is support wcn chip for unisoc.
	  if you want to use 23xx series wcn chip of unisoc.
	  please say "y".

config WCN_INTEG
	bool "WCN Integrated chip Support"
	depends on SC23XX
	default n
	help
	  This is support wcn chip for unisoc.
	  If you want to use wcn integrated chip of unisoc.
	  Please say "y".

config SC2355
	bool "SC2355 chip Support"
	depends on SC23XX
	default n
	help
	  This is support wcn chip for unisoc.
	  If you want to use sc2355 chip of unisoc.
	  Please say "y".

config UMW2652
	bool "UMW2652 chip Support"
	depends on SC23XX
	default n
	help
	  This is support wcn chip for unisoc.
	  If you want to use umw2652 chip of unisoc.
	  Please say "y".

config UMW2653
	bool "UMW2653 chip Support"
	depends on SC23XX
	default n
	help
	  This is support wcn chip for unisoc.
	  If you want to use umw2653 chip of unisoc.
	  Please say "y".

endmenu
```

## kernel_modules/kernel5.15/wcn/wlan/wlan_combo/Kconfig
```kconfig
#
# Unisoc Wlan Combo configuration
#
menu "Unisoc Wlan Device Drivers"
config UNISOC_WLAN_COMBO
	tristate "UNISOC_WLAN_COMBO"
	depends on CFG80211
	help
	  This module adds support for Unisoc sc23xx series wcn chipset.
	  The drivers is a fullmac driver, which make use of cfg80211 stack.

	  If you choose to build a module, it will be called sprd_wlan_combo.ko.

endmenu
```
