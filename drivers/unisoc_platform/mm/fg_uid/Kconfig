## drivers/unisoc_platform/mm/fg_uid/Kconfig
```kconfig
# SPDX-License-Identifier: GPL-2.0-only

config UNISOC_FG_TASK_UID
	tristate "foreground task uid"
	default y
	help
	  This option enable to show uid information fo foreground apps.
```
